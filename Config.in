## Config.in
```kconfig
config BR2_PACKAGE_NHATTHANH_MAX6675
	bool "nhatthanh_max6675"
	depends on BR2_LINUX_KERNEL
	help
	  Kernel driver cho cam bien nhiet do MAX6675 (giao tiep SPI).
	  Thuc hien boi Nhat Thanh cho BTL He dieu hanh nhung.
```

## nhatthanhBTL/Config.in
```kconfig
config BR2_PACKAGE_NHATTHANH_BTL
        bool "nhatthanh_BTL"
        help
          Ung dung tong hop dieu khien OLED, MAX6675, LED va Nut bam.
          Su dung Multi-threading va Mutex.
```

## nhatthanh_oled/Config.in
```kconfig
config BR2_PACKAGE_NHATTHANH_OLED
	bool "nhatthanh_oled"
	depends on BR2_LINUX_KERNEL
	help
	  Kernel driver cho man hinh OLED SSD1306 (I2C) cua Nhat Thanh.
```
